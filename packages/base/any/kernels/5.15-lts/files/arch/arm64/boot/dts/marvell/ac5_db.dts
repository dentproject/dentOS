// SPDX-License-Identifier: (GPL-2.0+ OR MIT)
/*
 * Device Tree For AC5_db.
 *
 * Copyright (C) 2021 Marvell
 *
 */
/*
 * Device Tree file for Marvell Alleycat 5 development board
 * This board file supports the B configuration of the board
 */

#include "ac5.dtsi"

&eth0 {
	status = "okay";
	fixed-link {
		speed = <1000>;
		full-duplex;
	};
};

&eth1 {
	status = "okay";
};

&usb1 {
	compatible = "chipidea,usb2";
	phys = <&usb1phy>;
	phy-names = "usb-phy";
	dr_mode = "peripheral";
};

